## components/aic8800/Kconfig
```kconfig
menu "AIC8800 WiFi (sun252i-f101)"
    choice AIC8800_CHIP
        prompt "Chip"
        default AIC8800D80
        config AIC8800D
            bool "AIC8800D"
        config AIC8800DW
            bool "AIC8800DW"
        config AIC8800DC
            bool "AIC8800DC (AIC8800D40)"
        config AIC8800D80
            bool "AIC8800D80"
    endchoice

    config AIC8800_P2P
        bool "Wi-Fi Direct (P2P), WPS and Hotspot 2.0"
        default y

    config AIC8800_WPA3
        bool "WPA3 (SAE)"
        default y
        help
            Build the SAE handshake of the supplicant on top of mbedTLS.

    config AIC8800_MEM_POOL_KB
        int "Memory pool of the driver (KiB)"
        default 384
endmenu
```

## components/esp_system/port/soc/sun252i-f101/Kconfig.cpu
```kconfig
config ESP_DEFAULT_CPU_FREQ_MHZ
    int "CPU frequency (MHz)"
    range 72 1008
    default 600
    help
        CPU frequency of the XuanTie C907 core. The download flow leaves it at 600 MHz; the start
        code raises PLL_CPU in steps of 72 MHz and tests the memory after each step (the limit of the
        PLL is 1008 MHz and the supply voltage is not changed). A step that fails the memory test is
        undone and the CPU stays at the last good frequency.

config ESP_RTC_F101_CLOCK_HOSC
    bool "Count the RTC seconds from the 24 MHz crystal"
    default y
    help
        The 32 kHz clock of the real time clock is the 24 MHz main crystal divided by 750: as accurate as the
        crystal, but it runs only while the chip is powered. Without it the clock keeps the source the boot
        code selected.
```
